## components/esp_cam_sensor/sensors/ov02c10/Kconfig
```kconfig
menu "OV02C10 Camera Sensor"

config CAMERA_OV02C10_AUTO_DETECT_MIPI_INTERFACE_SENSOR
    bool "Auto-detect OV02C10 MIPI-CSI sensor"
    default y
    help
        Enables automatic detection of the OV02C10 camera sensor
        on the MIPI-CSI interface.

endmenu
```

## components/esp_cam_sensor/sensors/ov02c10/Kconfig.ov02c10
```kconfig
menu "OV02C10 Camera Sensor"

config CAMERA_OV02C10
    bool "Enable OV02C10 camera sensor"
    default y
    help
        Enable OV02C10 camera sensor driver.

config CAMERA_OV02C10_AUTO_DETECT_MIPI_INTERFACE_SENSOR
    bool "Auto-detect OV02C10 MIPI-CSI sensor"
    default y
    depends on CAMERA_OV02C10
    help
        Enables automatic detection of the OV02C10 camera sensor
        on the MIPI-CSI interface.

choice CAMERA_OV02C10_IPA_JSON_CONFIGURATION_FILE
    prompt "IPA JSON Configuration File"
    default CAMERA_OV02C10_DEFAULT_IPA_JSON_CONFIGURATION_FILE
    depends on CAMERA_OV02C10
    help
        Selects the ISP tuning (IPA) JSON embedded and matched to this
        sensor's registered name at build time. Without one selected,
        esp_video_init logs "failed to get configuration to initialize
        ISP controller" and the ISP runs uncalibrated (no AE/AWB/LSC).

    config CAMERA_OV02C10_DEFAULT_IPA_JSON_CONFIGURATION_FILE
        bool "Default"
        help
            Uses sensors/ov02c10/cfg/ov02c10_default.json shipped next to
            this driver.

    config CAMERA_OV02C10_CUSTOMIZED_IPA_JSON_CONFIGURATION_FILE
        bool "Customized"
        help
            Points at a JSON file you specify with an absolute path below.
endchoice

config CAMERA_OV02C10_CUSTOMIZED_IPA_JSON_CONFIGURATION_FILE_PATH
    string "Customized IPA JSON Configuration File Path"
    depends on CAMERA_OV02C10_CUSTOMIZED_IPA_JSON_CONFIGURATION_FILE
    default ""

endmenu
```
